## main/Kconfig.projbuild
```kconfig
menu "DLNA App Configuration"


config WIFI_SSID
    string "WiFi SSID"
    default "No Study Come Play1"
    help
	SSID (network name) for the example to connect to.

config WIFI_PASSWORD
    string "WiFi Password"
    default "1234567890"
    help
	WiFi password (WPA or WPA2) for the example to use.

endmenu
```

## sdkconfig.defaults
```kconfig
#
# Serial flasher config
#

CONFIG_FREERTOS_ENABLE_BACKWARD_COMPATIBILITY=y
# 增加任务看门狗超时，给首次 MP3 解码更多时间
CONFIG_ESP_TASK_WDT_TIMEOUT_S=10
# 允许任务栈放到外部 RAM（audio_task 等大任务）
CONFIG_FREERTOS_TASK_CREATE_ALLOW_EXT_MEM=y

#
# SPI RAM config
#
CONFIG_SPIRAM=y
CONFIG_SPIRAM_BOOT_INIT=y
CONFIG_SPIRAM_USE_MALLOC=y
CONFIG_SPIRAM_SPEED_80M=y
CONFIG_SPIRAM_ALLOW_STACK_EXTERNAL_MEMORY=y
CONFIG_SPIRAM_TRY_ALLOCATE_WIFI_LWIP=y
CONFIG_SPIRAM_TRY_ALLOCATE_WIFI_LWIP=y
CONFIG_SPIRAM_MALLOC_RESERVE_INTERNAL=32768
# 关键：小对象（<=1024 字节）留内部 DRAM，大对象分配去 PSRAM
# 防止 semaphore、DMA 描述符、WiFi 管理结构被挤到 PSRAM 导致崩溃
CONFIG_SPIRAM_MALLOC_ALWAYSINTERNAL=1024

# Increase default app partition size to accommodate console example
# by providing new partition table in "partitions_dlna_example.csv"
CONFIG_PARTITION_TABLE_CUSTOM=y
CONFIG_PARTITION_TABLE_CUSTOM_FILENAME="partitions_dlna_example.csv"

CONFIG_ESP_TLS_INSECURE=y
CONFIG_ESP_TLS_SKIP_SERVER_CERT_VERIFY=y

CONFIG_ESP_SYSTEM_EVENT_TASK_STACK_SIZE=3072

CONFIG_FREERTOS_TASK_CREATE_ALLOW_EXT_MEM=y

#
# === LwIP / TCP 网络优化（HTTP 音频流更流畅，抄自 airplay-esp32）===
#
CONFIG_LWIP_MAX_SOCKETS=16
CONFIG_LWIP_MSS=1460
# TCP 发送/接收窗口大小（较大以提升吞吐）
CONFIG_LWIP_TCP_WND_DEFAULT=29200
CONFIG_LWIP_TCP_SND_BUF_DEFAULT=29200
CONFIG_LWIP_SO_RCVBUF=y
CONFIG_LWIP_SO_REUSE=y
CONFIG_LWIP_TCP_RECVMBOX_SIZE=12
CONFIG_LWIP_UDP_RECVMBOX_SIZE=6
CONFIG_LWIP_TCP_KEEP_CONNECTION_WHEN_IP_CHANGES=y
CONFIG_LWIP_IPV4=y
CONFIG_LWIP_ICMP=y
CONFIG_LWIP_TCP_MAXRTX=12
CONFIG_LWIP_TCP_SYNMAXRTX=6
# TCP Window scaling：提升吞吐
CONFIG_LWIP_WND_SCALE=y
CONFIG_LWIP_RCV_WND_SCALE_FACTOR=2

#
# === HTTP server（custom_dlna）相关 ===
#
CONFIG_HTTPD_MAX_REQ_HDR_LEN=1024
CONFIG_HTTPD_MAX_URI_LEN=512
CONFIG_HTTPD_ERR_RESP_NO_KEY_RETURN_ONFAIL=n

#
# === WiFi 802.11 吞吐优化（抄自 airplay-esp32）===
#
CONFIG_ESP_WIFI_STATIC_RX_BUFFER_NUM=16
CONFIG_ESP_WIFI_DYNAMIC_RX_BUFFER_NUM=64
CONFIG_ESP_WIFI_STATIC_TX_BUFFER=n
CONFIG_ESP_WIFI_DYNAMIC_TX_BUFFER_NUM=64
CONFIG_ESP32_WIFI_AMPDU_TX_ENABLED=y
CONFIG_ESP32_WIFI_AMPDU_RX_ENABLED=y
CONFIG_ESP32_WIFI_NVS_ENABLED=y
CONFIG_ESP32_WIFI_TASK_PINNED_TO_CORE_0=y
CONFIG_ESP32S3_WIFI_NVS_ENABLED=y

#
# === mDNS（可选，方便发现设备；与 SSDP 共存无冲突）===
#
CONFIG_MDNS_MAX_SERVICES=10
CONFIG_MDNS_TASK_CREATE_FROM_SPIRAM=y
CONFIG_MDNS_MEMORY_ALLOC_SPIRAM=y

#
# === GMF 音频框架 ===
#
# 禁用 codec_dev RX（纯播放设备，无录音）
CONFIG_GMF_IO_INIT_CODEC_DEV_RX=n
# HTTP reader 大缓冲（512KB PSRAM），吸收网络抖动
CONFIG_GMF_IO_HTTP_READER_OUT_BUF_SIZE=524288
# HTTP reader 每次读取块大小：16KB（匹配 HTTP client buffer）
CONFIG_GMF_IO_HTTP_READER_IO_SIZE=16384
# HTTP reader 任务：优先级>=管线任务(8)，8KB 栈，PSRAM 栈，core0（WiFi 同核）
CONFIG_GMF_IO_HTTP_READER_TASK_PRIORITY=9
CONFIG_GMF_IO_HTTP_READER_TASK_STACK=8192
CONFIG_GMF_IO_HTTP_READER_STACK_IN_EXT=y
# 禁用重采样（I2S 跟随源采样率，参考 Jw-Y1）
CONFIG_GMF_AUDIO_EFFECT_INIT_RATE_CVT=n
# ALC 软音量（-64~63 dB，替代 ADF 的 i2s_alc_volume_set）
CONFIG_GMF_AUDIO_EFFECT_INIT_ALC=y
# 通道转换：不需要（DLNA 源已是立体声）
CONFIG_GMF_AUDIO_EFFECT_INIT_CH_CVT=n
# 位深转换：不需要（DLNA 源已是 16-bit，PCM5102A 直接输出）
CONFIG_GMF_AUDIO_EFFECT_INIT_BIT_CVT=n
# 解码器：MP3（choice，只能选一个；解码器本身支持自动探测格式）
CONFIG_GMF_AUDIO_CODEC_INIT_DECODER=y
CONFIG_GMF_AUDIO_CODEC_INIT_ENCODER=n
CONFIG_GMF_AUDIO_CODEC_DECODER_TYPE_MP3=y
# codec_dev 输出缓冲
# codec_dev 输出缓冲（32KB ≈ 185ms @44.1kHz/16bit/stereo，减少音频延迟）
CONFIG_GMF_IO_CODEC_DEV_TX_OUT_BUF_SIZE=32768
CONFIG_GMF_IO_CODEC_DEV_TX_IO_SIZE=4096
# codec_dev 输出任务在 core1（与 WiFi core0 分开）
CONFIG_GMF_IO_CODEC_DEV_TX_TASK_CORE=1
CONFIG_GMF_IO_CODEC_DEV_TX_TASK_PRIORITY=9
# PSRAM 栈
CONFIG_GMF_IO_CODEC_DEV_TX_STACK_IN_EXT=y

#
# === FreeRTOS tick / 任务调度优化 ===
#
CONFIG_FREERTOS_HZ=1000
CONFIG_FREERTOS_USE_TICKLESS_IDLE=n
CONFIG_FREERTOS_CHECK_STACKOVERFLOW_CANARY=y

#
# === 编译器优化（-O2 性能优先，音频播放更稳）===
#
CONFIG_COMPILER_OPTIMIZATION_PERF=y

#
# === CPU 频率与日志级别 ===
#
CONFIG_LOG_DEFAULT_LEVEL=3
CONFIG_LOG_COLORS=y
CONFIG_ESP32S3_DEFAULT_CPU_FREQ_240=y
CONFIG_ESP_DEFAULT_CPU_FREQ_MHZ=240

#
# === Flash 模式（esp32s3 qio + 80MHz）===
#
CONFIG_ESPTOOLPY_FLASHMODE_QIO=y
CONFIG_ESPTOOLPY_FLASHMODE="qio"
CONFIG_ESPTOOLPY_FLASHFREQ_80M=y
CONFIG_ESPTOOLPY_FLASHSIZE_16MB=y
# 抑制 I2C 驱动弃用警告（ESP-ADF v2.8 兼容）
CONFIG_I2C_SUPPRESS_DEPRECATE_WARN=y

#
# === LVGL PNG 解码（lodepng，封面图）===
#
CONFIG_LV_USE_PNG=y

# LVGL 字体（CJK + Montserrat 12）
CONFIG_LV_FONT_MONTSERRAT_12=y
CONFIG_LV_FONT_SIMSUN_16_CJK=y
CONFIG_LV_FONT_FMT_TXT_LARGE=y
```

## sdkconfig.defaults.esp32s3
```kconfig
CONFIG_IDF_TARGET="esp32s3"
CONFIG_ESPTOOLPY_FLASHMODE="qio"
CONFIG_ESPTOOLPY_FLASHFREQ_80M=y
CONFIG_ESPTOOLPY_FLASHSIZE_16MB=y
CONFIG_OPTIMIZATION_LEVEL_RELEASE=y
CONFIG_IDF_CMAKE=y
CONFIG_IDF_TARGET_ARCH_XTENSA=y
CONFIG_IDF_TARGET="esp32s3"
CONFIG_IDF_TARGET_ESP32S3=y
CONFIG_IDF_FIRMWARE_CHIP_ID=0x0009
CONFIG_ESP_DEFAULT_CPU_FREQ_MHZ_240=y
CONFIG_ESP_DEFAULT_CPU_FREQ_MHZ=240
#
# SPI RAM config
#
CONFIG_ESP32S3_SPIRAM_SUPPORT=y
CONFIG_SPIRAM_MODE_OCT=y
```
